## conf/local.conf
```bitbake
include "application.conf"

croissants.excluded_emails = "croissants@zengularity.com"

croissants.included_domains = "zengularity.com, gmail.com"

mail.contact = "croissants@zengularity.com"
mail.all = "sylvain.luce@gmail.com"

api.secret = "HOdbsN68AWSmV3S5mYelljFh774TvTC1s6hEY0D1HcWkuTluhi4j3Fw1z9pjmpNt"

play.mailer.host = "smtp.int.zmx.fr"
```
